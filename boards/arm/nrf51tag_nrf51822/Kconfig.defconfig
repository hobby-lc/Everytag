## boards/arm/nrf51tag_nrf51822/nrf51tag_nrf51822_defconfig
```kconfig
# SPDX-License-Identifier: Apache-2.0

# enable GPIO
CONFIG_GPIO=y

# enable uart driver
CONFIG_SERIAL=y

# enable console
CONFIG_CONSOLE=y
CONFIG_UART_CONSOLE=y

CONFIG_CLOCK_CONTROL_NRF_K32SRC_RC=y

CONFIG_WATCHDOG=y
CONFIG_I2C=n

CONFIG_BT_HCI_VS=y
CONFIG_BT_CTLR=y
```
